VERSION ""

NS_ :

BS_:

BU_:

BO_ 16 ST1VER: 1 Vector__XXX
    SG_ FRVersion : 0|4@1+ (0,0) [0|8031.875] "" Vector__XXX

BO_ 17 ST1TEMP: 1 Vector__XXX
    SG_ Battery Temp : 0|8@1+ (0.00390625,0) [0|250.996] "km/h" Vector__XXX

BO_ 18 ST1CUR: 1 Vector__XXX
    SG_ BatteryCurrent : 0|0@1+ (0,0) [0|0] "" Vector__XXX

BO_ 19 ST1VO: 1 Vector__XXX
    SG_ BatteryVoltage : 0|0@1+ (0,0) [0|0] "" Vector__XXX

BO_ 20 ST2PWMRE: 4 Vector__XXX
    SG_ MotorPWM : 0|8@1+ (0,0) [0|0] "" Vector__XXX

BO_ 21 ST2VER: 1 Vector__XXX
    SG_ ST2VER : 0|8@1+ (0,0) [0|0] "" Vector__XXX
    SG_ BatteryTemp : 0|8@1+ (0.00390625,0) [0|250.996] "km/h" Vector__XXX

BO_ 22 ST1FW: 8 Vector__XXX
    SG_ FirmwareData : 0|8@1+ (0,0) [0|255] "" Vector__XXX

BO_ 23 ST2FW: 8 Vector__XXX
    SG_ FirmwareData : 0|8@1+ (0,0) [0|255] "" Vector__XXX

BO_ 24 ST2FWN: 8 Vector__XXX
    SG_ FirmwareData : 0|8@1+ (0,0) [0|255] "" Vector__XXX

BO_ 25 ST1FWN: 8 Vector__XXX
    SG_ FirmwareData : 0|8@1+ (0,0) [0|255] "" Vector__XXX

BO_ 26 ST1END: 1 Vector__XXX
    SG_ EndOfFile : 0|8@1+ (0,0) [0|0] "" Vector__XXX

BO_ 27 ST2END: 1 Vector__XXX
    SG_ EndOfFile : 0|8@1+ (0,0) [0|0] "" Vector__XXX

BO_ 28 ST1ACK: 1 Vector__XXX
    SG_ Acknowledgment : 0|8@1+ (0,0) [0|0] "" Vector__XXX

BO_ 29 ST2ACK: 1 Vector__XXX
    SG_ Acknowledgment : 0|8@1+ (0,0) [0|0] "" Vector__XXX

BO_ 30 ST1NL: 1 Vector__XXX
    SG_ NextLine : 0|8@1+ (0,0) [0|0] "" Vector__XXX

BO_ 31 ST2NL: 1 Vector__XXX
    SG_ NextLine : 0|8@1+ (0,0) [0|0] "" Vector__XXX

BO_ 32 ST1ENDFW: 1 Vector__XXX
    SG_ EndOfFileTransmission : 0|8@1+ (0,0) [0|0] "" Vector__XXX

BO_ 33 ST2ENDFW: 1 Vector__XXX
    SG_ EndOfFileTransmission : 0|8@1+ (0,0) [0|0] "" Vector__XXX

BO_ 34 ST1RST: 1 Vector__XXX
    SG_ Restart : 0|8@1+ (0,0) [0|0] "" Vector__XXX

BO_ 35 ST2RST: 1 Vector__XXX
    SG_ Restart : 0|8@1+ (0,0) [0|0] "" Vector__XXX

BO_ 36 ST1STAPP: 1 Vector__XXX
    SG_ StartApp : 0|8@1+ (0,0) [0|0] "" Vector__XXX

BO_ 37 ST2STAPP: 1 Vector__XXX
    SG_ StartApp : 0|8@1+ (0,0) [0|0] "" Vector__XXX

BO_ 38 ST1TOST2: 1 Vector__XXX
    SG_ Battery Temp : 0|8@1+ (0.00390625,0) [0|250.996] "km/h" Vector__XXX

BO_ 39 ST1TOST2C: 1 Vector__XXX
    SG_ BatteryCurrent : 0|0@1+ (0,0) [0|0] "" Vector__XXX

BO_ 40 ST1TOST2V: 1 Vector__XXX
    SG_ BatteryVoltage : 0|0@1+ (0,0) [0|0] "" Vector__XXX
VERSION ""

NS_ :

BS_:

BU_:

BO_ 16 ST1VER: 1 Vector__XXX
    SG_ FRVersion : 0|4@1+ (0,0) [0|8031.875] "" Vector__XXX

BO_ 17 ST1TEMP: 1 Vector__XXX
    SG_ Battery Temp : 0|8@1+ (0.00390625,0) [0|250.996] "km/h" Vector__XXX

BO_ 18 ST1CUR: 1 Vector__XXX
    SG_ BatteryCurrent : 0|0@1+ (0,0) [0|0] "" Vector__XXX

BO_ 19 ST1VO: 1 Vector__XXX
    SG_ BatteryVoltage : 0|0@1+ (0,0) [0|0] "" Vector__XXX

BO_ 20 ST2PWMRE: 4 Vector__XXX
    SG_ MotorPWM : 0|8@1+ (0,0) [0|0] "" Vector__XXX

BO_ 21 ST2VER: 1 Vector__XXX
    SG_ ST2VER : 0|8@1+ (0,0) [0|0] "" Vector__XXX
    SG_ BatteryTemp : 0|8@1+ (0.00390625,0) [0|250.996] "km/h" Vector__XXX

BO_ 22 ST1FW: 8 Vector__XXX
    SG_ FirmwareData : 0|8@1+ (0,0) [0|255] "" Vector__XXX

BO_ 23 ST2FW: 8 Vector__XXX
    SG_ FirmwareData : 0|8@1+ (0,0) [0|255] "" Vector__XXX

BO_ 24 ST2FWN: 8 Vector__XXX
    SG_ FirmwareData : 0|8@1+ (0,0) [0|255] "" Vector__XXX

BO_ 25 ST1FWN: 8 Vector__XXX
    SG_ FirmwareData : 0|8@1+ (0,0) [0|255] "" Vector__XXX

BO_ 26 ST1END: 1 Vector__XXX
    SG_ EndOfFile : 0|8@1+ (0,0) [0|0] "" Vector__XXX

BO_ 27 ST2END: 1 Vector__XXX
    SG_ EndOfFile : 0|8@1+ (0,0) [0|0] "" Vector__XXX

BO_ 28 ST1ACK: 1 Vector__XXX
    SG_ Acknowledgment : 0|8@1+ (0,0) [0|0] "" Vector__XXX

BO_ 29 ST2ACK: 1 Vector__XXX
    SG_ Acknowledgment : 0|8@1+ (0,0) [0|0] "" Vector__XXX

BO_ 30 ST1NL: 1 Vector__XXX
    SG_ NextLine : 0|8@1+ (0,0) [0|0] "" Vector__XXX

BO_ 31 ST2NL: 1 Vector__XXX
    SG_ NextLine : 0|8@1+ (0,0) [0|0] "" Vector__XXX

BO_ 32 ST1ENDFW: 1 Vector__XXX
    SG_ EndOfFileTransmission : 0|8@1+ (0,0) [0|0] "" Vector__XXX

BO_ 33 ST2ENDFW: 1 Vector__XXX
    SG_ EndOfFileTransmission : 0|8@1+ (0,0) [0|0] "" Vector__XXX

BO_ 34 ST1RST: 1 Vector__XXX
    SG_ Restart : 0|8@1+ (0,0) [0|0] "" Vector__XXX

BO_ 35 ST2RST: 1 Vector__XXX
    SG_ Restart : 0|8@1+ (0,0) [0|0] "" Vector__XXX

BO_ 36 ST1STAPP: 1 Vector__XXX
    SG_ StartApp : 0|8@1+ (0,0) [0|0] "" Vector__XXX

BO_ 37 ST2STAPP: 1 Vector__XXX
    SG_ StartApp : 0|8@1+ (0,0) [0|0] "" Vector__XXX

BO_ 38 ST1TOST2: 1 Vector__XXX
    SG_ Battery Temp : 0|8@1+ (0.00390625,0) [0|250.996] "km/h" Vector__XXX

BO_ 39 ST1TOST2C: 1 Vector__XXX
    SG_ BatteryCurrent : 0|0@1+ (0,0) [0|0] "" Vector__XXX

BO_ 40 ST1TOST2V: 1 Vector__XXX
    SG_ BatteryVoltage : 0|0@1+ (0,0) [0|0] "" Vector__XXX
